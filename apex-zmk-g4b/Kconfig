## apex-zmk-g4b/dts/bindings/behaviors/apex,behavior-actuation.yaml
```yaml
# Copyright (c) 2026
# SPDX-License-Identifier: MIT

description: |
  Actuation point and rapid trigger, adjustable from the keymap.

  These sit under legends the keycaps already carry - I and O for actuation up
  and down, T for rapid trigger - which were inert while both settings were
  build-time constants.

  The parameter selects the action: 0 deeper, 1 shallower, 2 rapid trigger up,
  3 rapid trigger down, 4 rapid trigger toggle. Use the ACT_* macros from
  dt-bindings/apex_actuation.h rather than the bare numbers.

compatible: "apex,behavior-actuation"

include: one_param.yaml
```

## apex-zmk-g4b/dts/bindings/behaviors/apex,behavior-analog-toggle.yaml
```yaml
# Copyright (c) 2026
# SPDX-License-Identifier: MIT

description: |
  Toggles the analog gamepad axis on and off from the keymap.

  The axis is off at boot because it is not universally welcome - a game that
  grabs the first controller it enumerates will ignore the keyboard - so it is
  opt-in per session rather than always live.

compatible: "apex,behavior-analog-toggle"

include: zero_param.yaml
```

## apex-zmk-g4b/dts/bindings/behaviors/apex,behavior-dfu.yaml
```yaml
# Copyright (c) 2026
# SPDX-License-Identifier: MIT

description: |
  Reboots into the Adafruit_nRF52_Bootloader (UF2/serial DFU) by writing the
  UF2 DFU magic to GPREGRET and resetting. Bound via a combo to Fn+Esc+RCtrl.

compatible: "apex,behavior-dfu"

include: zero_param.yaml
```

## apex-zmk-g4b/dts/bindings/behaviors/apex,behavior-studio-toggle.yaml
```yaml
# Copyright (c) 2026
# SPDX-License-Identifier: MIT

description: |
  Toggles Studio's USB RPC interface on and off from the keymap.

  It is off at boot so its USB endpoint is free for the optional gamepad; the
  two share the last free endpoint and only one fits at a time, so enabling
  Studio over USB drops the gamepad. Studio over Bluetooth is a separate
  transport and is always available.

compatible: "apex,behavior-studio-toggle"

include: zero_param.yaml
```

## apex-zmk-g4b/dts/bindings/flash/apex,g4b-spinor.yaml
```yaml
# SPDX-License-Identifier: MIT
description: |
  Apex Pro Mini WL external FM25Q08A SPI-NOR (1 MiB), driven direct-register on
  SPIM0 with a bit-banged chip select by src/flash_spinor_g4b.c. Exposed as a
  Zephyr flash device so NVS/settings can live on the freed external chip. Not on
  a Zephyr SPI bus (which would pull in CONFIG_SPI/GPIO/PINCTRL that the build
  verifier forbids). Put a fixed-partitions child under it for storage.

compatible: "apex,g4b-spinor"

include: [base.yaml]

properties:
  reg:
    required: true
  erase-block-size:
    type: int
    required: true
    description: Erase sector size in bytes (4096).
  write-block-size:
    type: int
    required: true
    description: Minimum write size in bytes (1 for SPI-NOR).
```

## apex-zmk-g4b/dts/bindings/kscan/steelseries,apex-g4b-spim-kscan.yaml
```yaml
# SPDX-License-Identifier: MIT

description: |
  Kscan bridge for the G4B STM32 SPIM3 link gate.

  The node deliberately carries no SPI phandle, no cs-gpios and no pinctrl. The
  link is driven by direct register access rather than the Zephyr SPI driver,
  because CONFIG_PINCTRL would apply pin configuration at init priority 50 -
  driving SCK/MOSI/MISO roughly two seconds before the control sequence runs,
  while the STM32 enable lines are still undriven. There is also no chip select
  on this link at all.

compatible: "steelseries,apex-g4b-spim-kscan"

include: kscan.yaml

properties:
  rows:
    type: int
    required: true
    const: 5
    description: Matrix rows in the 60% ANSI transform.
  columns:
    type: int
    required: true
    const: 14
    description: Matrix columns in the 60% ANSI transform.
```

## apex-zmk-slot/Kconfig
```kconfig
# SPDX-License-Identifier: MIT

DT_COMPAT_STEELSERIES_APEX_STM32_KSCAN := steelseries,apex-stm32-kscan

config APEX_STM32_KSCAN
    bool
    default $(dt_compat_enabled,$(DT_COMPAT_STEELSERIES_APEX_STM32_KSCAN))
    depends on KSCAN
    help
      Safe bring-up scanner for the stock Apex Pro Mini Wireless STM32.
      The initial implementation exposes the ZMK kscan device and accepts
      externally supplied key bitmaps, but performs no SPI transactions.

if APEX_STM32_KSCAN

module = APEX_STM32_KSCAN
module-str = Apex STM32 kscan
source "subsys/logging/Kconfig.template.log_config"

endif

config APEX_RECOVERY
    bool "Legacy SteelSeries vendor-bootloader recovery path"
    depends on SOC_NRF52833
    help
      STOCK-LOADER BUILDS ONLY. Adds a bounded automatic recovery path and, when a shell transport is
      enabled, explicit recovery commands. Recovery invalidates only the first
      page of the application slot and resets into the preserved vendor
      bootloader.

if APEX_RECOVERY

config APEX_RECOVERY_AUTO_RETURN_SECONDS
    int "Automatic canary return delay in seconds"
    default 0
    range 0 300
    help
      Non-zero values schedule a one-shot canary return to the vendor
      bootloader. Set to zero for a persistent image.

endif
```

## apex-zmk-slot/boards/steelseries/apex_pro_mini_wl/Kconfig.apex_pro_mini_wl
```kconfig
# SPDX-License-Identifier: MIT

config BOARD_APEX_PRO_MINI_WL
    select SOC_NRF52833_QIAA
    select ZMK_BOARD_COMPAT if BOARD_APEX_PRO_MINI_WL_NRF52833_ZMK
```

## apex-zmk-slot/boards/steelseries/apex_pro_mini_wl/Kconfig.defconfig
```kconfig
# SPDX-License-Identifier: MIT

if BOARD_APEX_PRO_MINI_WL

config ZMK_KEYBOARD_NAME
    string
    default "Apex Pro Mini WL"

if USB_DEVICE_STACK

config USB_NRFX
    default y

endif

config BT_CTLR
    default BT

endif
```

## apex-zmk-slot/boards/steelseries/apex_pro_mini_wl/apex_pro_mini_wl_nrf52833_canary_defconfig
```kconfig
# SPDX-License-Identifier: MIT

CONFIG_ARM_MPU=n
CONFIG_HW_STACK_PROTECTION=n
CONFIG_SRAM_SIZE=116
CONFIG_CLOCK_CONTROL_NRF_K32SRC_RC=y
CONFIG_CLOCK_CONTROL_NRF_K32SRC_250PPM=y
CONFIG_USE_DT_CODE_PARTITION=y
```

## apex-zmk-slot/boards/steelseries/apex_pro_mini_wl/board.yml
```yaml
board:
  name: apex_pro_mini_wl
  full_name: SteelSeries Apex Pro Mini Wireless
  vendor: steelseries
  socs:
    - name: nrf52833
      variants:
        - name: zmk
        - name: canary
```

## apex-zmk-slot/dts/bindings/kscan/steelseries,apex-stm32-kscan.yaml
```yaml
description: |
  Safe bring-up keyboard scanner for the stock STM32G071 Hall controller in
  the SteelSeries Apex Pro Mini Wireless. The initial driver does not access
  hardware. A future transport driver can feed decoded 70-bit key maps into
  apex_stm32_kscan_ingest_bitmap().

compatible: "steelseries,apex-stm32-kscan"

include: kscan.yaml

properties:
  rows:
    type: int
    required: true
    const: 5

  columns:
    type: int
    required: true
    const: 14
```

## dongle/boards/steelseries/apex_receiver/apex_receiver_nrf52833_defconfig
```kconfig
CONFIG_ARM_MPU=y
CONFIG_HW_STACK_PROTECTION=y
CONFIG_USE_DT_CODE_PARTITION=y
CONFIG_CLOCK_CONTROL_NRF_K32SRC_RC=y
CONFIG_CLOCK_CONTROL_NRF_K32SRC_500PPM=y
```

## dongle/boards/steelseries/apex_receiver/board.yml
```yaml
board:
  name: apex_receiver
  full_name: Apex Pro Mini Wireless receiver
  vendor: steelseries
  socs:
    - name: nrf52833
```

## radio/Kconfig
```kconfig
# SPDX-License-Identifier: MIT
config APEX_RADIO_THREAD_PRIORITY
    int "Radio transaction thread priority"
    range 0 14
    default 0
    help
      Preemptible Zephyr priority for authenticated packet processing. Lower
      values run first. USB interrupts and cooperative workqueues still take
      precedence. The thread blocks while transmitting or waiting for traffic.

config APEX_RADIO_BENCHMARK
    bool "Enable the bounded radio delivery benchmark"
    default n
    depends on APEX_G4B_RADIO_INPUT && SHELL
    help
      Add apex radio_bench to send 1000 empty keyboard reports through the
      normal radio and receiver USB path. Requires direct USB output and
      stops after ten seconds or an endpoint/session change. Development only.

config APEX_RADIO_KEYBOARD_EVENT_RX
    bool "Wake the keyboard radio thread on packet reception"
    default n
    depends on APEX_G4B_RADIO_INPUT && APEX_RADIO_HOPPING
    help
      Route RADIO DISABLED through PPI channel 19 to EGU3. This uses
      SWI3/EGU3 instead of replacing Bluetooth's direct RADIO interrupt.
      Enabled only after Bluetooth shutdown; incompatible with another EGU3
      or nrfx software-interrupt user.

config APEX_RADIO_TEST_CHANNEL
    int "Fixed radio test channel (MHz above 2400)"
    range 0 80
    default 40
    help
      Both devices must use the same value. This selects a single frequency
      for development measurements; it does not enable channel hopping.

config APEX_RADIO_HOPPING
    bool "Experimental timed channel hopping"
    default n
    depends on APEX_G4B_RADIO_INPUT || APEX_RECEIVER_RADIO_INPUT
    help
      Negotiate a session-bound channel map and hop in 20 ms slots. Owns
      TIMER2 and PPI channels 17, 18 and 19 after Bluetooth has shut down.
      Requires matching keyboard and receiver builds. Not a 1 kHz scheduler.
```
